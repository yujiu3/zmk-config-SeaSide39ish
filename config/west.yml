## config/west.yml
```yaml
manifest:
  remotes:
    - name: zmkfirmware
      url-base: https://github.com/zmkfirmware
    #- name: inorichi
      #url-base: https://github.com/inorichi
    - name: sekigon-gonnoc  # <-- PAW3222
      url-base: https://github.com/sekigon-gonnoc
    - name: kot149  # <-- scroll snap
      url-base: https://github.com/kot149
    - name: caksoylar
      url-base: https://github.com/caksoylar
  projects:
    - name: zmk
      remote: zmkfirmware
      revision: v0.3.0
      import: app/west.yml
    #- name: zmk-pmw3610-driver
      #remote: inorichi
      #revision: main
    - name: zmk-driver-paw3222
      remote: sekigon-gonnoc
      revision: main
    - name: zmk-scroll-snap
      remote: kot149
      revision: v1
    - name: zmk-rgbled-widget
      remote: caksoylar
      revision: v0.3-branch
  self:
    path: config
```
